## meta-easysaver-master/conf/layer.conf
```bitbake
# We have a conf and classes directory, add to BBPATH
BBPATH .= ":${LAYERDIR}"

# We have recipes-* directories, add to BBFILES
BBFILES += "${LAYERDIR}/recipes-*/*/*.bb \
	${LAYERDIR}/recipes-*/*/*.bbappend"

BBFILE_COLLECTIONS += "easysaver"
BBFILE_PATTERN_easysaver = "^${LAYERDIR}/"
BBFILE_PRIORITY_easysaver = "6"
```
